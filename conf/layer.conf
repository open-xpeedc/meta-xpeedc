## conf/layer.conf
```bitbake
# We have a conf and classes directory, append to BBPATH
BBPATH .= ":${LAYERDIR}"

# We have a recipes directory, add to BBFILES
BBFILES += "${LAYERDIR}/recipes-*/*.bb ${LAYERDIR}/recipes-*/*.bbappend \
            ${LAYERDIR}/recipes-*/*/*.bb ${LAYERDIR}/recipes-*/*/*.bbappend"

BBFILE_COLLECTIONS += "xpeedc-layer"
BBFILE_PATTERN_xpeedc-layer := "^${LAYERDIR}/"
BBFILE_PRIORITY_xpeedc-layer = "7"

OEA-META-ULTRAMINI-BASE := '${@os.path.normpath("${LAYERDIR}/")}'
```

## conf/machine/xpeedc.conf
```bitbake
#@TYPE: Machine
#@NAME: Golden Interstar Xpeed LX Class
#@DESCRIPTION: Machine configuration for the Golden Interstar Xpeed LX Class

CHIPSET = "bcm7362"

MACHINE_FEATURES += "textlcd dvb-c blindscan-dvbc"
MACHINE_KERNEL_PR = "r0"

require conf/machine/include/xpeedc.inc
```

## conf/machine/xpeedlxpro.conf
```bitbake
#@TYPE: Machine
#@NAME: Xpeed LX Pro
#@DESCRIPTION: Machine configuration for the Xpeed LX PRO

require conf/machine/include/xpeedc.inc

IMAGEDIR ?= "xpeedlxpro"

PREFERRED_PROVIDER_virtual/kernel = "linux-${MACHINE}"
PREFERRED_VERSION_linux-${MACHINE} = "3.14.2"

PREFERRED_PROVIDER_virtual/blindscan-dvbc = "xpeedlxpro-blindscan-utils-${MACHINE}"
PREFERRED_PROVIDER_virtual/blindscan-dvbs = "xpeedlxpro-blindscan-utils-${MACHINE}"

MACHINE_EXTRA_RRECOMMENDS = " \
	xpeedlxpro-cfe \
	"

MKUBIFS_ARGS = "-m 2048 -e 126976 -c 4096"
UBINIZE_ARGS = "-m 2048 -p 128KiB"

MACHINE_FEATURES += " blindscan-dvbs dvbusb"

CHIPSET = "bcm7362"

IMAGE_CMD_ubi_append = " \
	mkdir -p ${DEPLOY_DIR_IMAGE}/${IMAGEDIR}; \
	cp ${DEPLOY_DIR_IMAGE}/splash.bin ${DEPLOY_DIR_IMAGE}/${IMAGEDIR}/; \
	cp ${DEPLOY_DIR_IMAGE}/cfe.bmp ${DEPLOY_DIR_IMAGE}/${IMAGEDIR}/; \
	cp ${DEPLOY_DIR_IMAGE}/splash.bmp ${DEPLOY_DIR_IMAGE}/${IMAGEDIR}/; \
	cp ${DEPLOY_DIR_IMAGE}/imageversion.bmp ${DEPLOY_DIR_IMAGE}/${IMAGEDIR}/; \
	cp ${DEPLOY_DIR_IMAGE}/kernel.bmp ${DEPLOY_DIR_IMAGE}/${IMAGEDIR}/; \
	cp ${DEPLOY_DIR_IMAGE}/rootfs.bmp ${DEPLOY_DIR_IMAGE}/${IMAGEDIR}/; \
	cp ${DEPLOY_DIR_IMAGE}/finished.bmp ${DEPLOY_DIR_IMAGE}/${IMAGEDIR}/; \
	cp ${DEPLOY_DIR_IMAGE}/${IMAGE_NAME}.rootfs.ubi ${DEPLOY_DIR_IMAGE}/${IMAGEDIR}/rootfs.bin; \
	gzip -9c ${DEPLOY_DIR_IMAGE}/vmlinux-${MACHINE}.bin > ${DEPLOY_DIR_IMAGE}/${IMAGEDIR}/kernel.bin; \
	echo ${DISTRO_NAME}-${DISTRO_VERSION}-${DATE} > ${DEPLOY_DIR_IMAGE}/${IMAGEDIR}/imageversion; \
	echo "flashing without confirmation" > ${DEPLOY_DIR_IMAGE}/${IMAGEDIR}/force; \
	cd ${DEPLOY_DIR_IMAGE}; \
	zip ${DISTRO_NAME}-${DISTRO_VERSION}-${MACHINE}_usb.zip ${IMAGEDIR}/*; \
	rm -Rf ${IMAGEDIR}; \
	"
```
